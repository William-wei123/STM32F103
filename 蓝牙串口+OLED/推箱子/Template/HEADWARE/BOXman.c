#include "BOXman.h"
#include "sys.h"
#include "OLED.h"
char boxs[8][1]=
{0xFF,0xC3,0xA5,0x99,0x99,0xA5,0xC3,0xFF};/*"未命名文件",0*/
/* (8 X 8 ) */
char goal[8][1]={0x81,0x42,0x3C,0x24,0x24,0x3C,0x42,0x81};/*"未命名文件",0*/
/* (8 X 8 ) */

char Wall[8][1]={0x00,0x18,0x3C,0x7E,0x7E,0x3C,0x18,0x00,/*"未命名文件",0*/
/* (8 X 8 ) */};
char man[8][1]={
0x00,0x60,0x70,0x38,0x1F,0x3F,0x78,0x60,/*"人",0*/
/* (8 X 8 , 华文琥珀 ) */
};
char Wall1[8][1]={0x00,0x00,0x00,0x00,/*" ",0*/
/* (4 X 8 , 华文宋体 ) */

0x00,0x00,0x00,0x00,/*" ",1*/
/* (4 X 8 , 华文宋体 ) */};
char good[8][1]={
0xFF,0xC3,0xBD,0xBD,0xBD,0xBD,0xC3,0xFF,/*"未命名文件",0*/
/* (8 X 8 ) */};
u8 explain[72][2]={ 

0x40,0x00,0x40,0x40,0x42,0x20,0xCC,0x1F,
0x00,0x20,0x50,0x50,0x4E,0x4C,0xC8,0x43,
0x48,0x40,0x7F,0x40,0xC8,0x4F,0x48,0x50,
0x48,0x50,0x40,0x5C,0x00,0x40,0x00,0x00,/*"选",0*/
/* (16 X 16 , 宋体 ) */

0x10,0x42,0x10,0x82,0xFF,0x7F,0x10,0x01,
0x00,0x00,0x82,0x10,0x86,0x12,0x4A,0x12,
0x52,0x12,0xA2,0xFF,0x52,0x12,0x4A,0x12,
0x86,0x12,0x80,0x10,0x80,0x00,0x00,0x00,/*"择",1*/
/* (16 X 16 , 宋体 ) */

0x00,0x81,0x00,0x81,0x10,0x41,0x11,0x41,
0x16,0x21,0x10,0x11,0x10,0x0D,0xF0,0x03,
0x10,0x0D,0x10,0x11,0x14,0x21,0x13,0x41,
0x10,0x41,0x00,0x81,0x00,0x81,0x00,0x00,/*"关",2*/
/* (16 X 16 , 宋体 ) */

0x40,0x00,0x40,0x00,0x40,0x00,0x40,0x00,
0x40,0x00,0x40,0x00,0xFF,0xFF,0x44,0x00,
0x44,0x00,0x44,0x02,0x44,0x04,0x44,0x08,
0x44,0x10,0x40,0x00,0x40,0x00,0x00,0x00,/*"卡",3*/
/* (16 X 16 , 宋体 ) */

0x00,0x00,0x00,0x00,0x00,0x00,0xC0,0x30,
0xC0,0x30,0x00,0x00,0x00,0x00,0x00,0x00,/*":",4*/
/* (8 X 16 , 宋体 ) */
};
char MARKING[40][2]={
0x80,0x00,0x40,0x80,0x20,0x40,0x90,0x20,
0x88,0x18,0x86,0x07,0x80,0x00,0x80,0x40,
0x80,0x80,0x83,0x40,0x8C,0x3F,0x10,0x00,
0x20,0x00,0x40,0x00,0x80,0x00,0x00,0x00,/*"分",0*/
/* (16 X 16 , 宋体 ) */

0x90,0x82,0x52,0x9A,0x34,0x56,0x10,0x63,
0xFF,0x22,0x10,0x52,0x34,0x8E,0x52,0x00,
0x80,0x80,0x70,0x40,0x8F,0x33,0x08,0x0C,
0x08,0x33,0xF8,0x40,0x08,0x80,0x00,0x00,/*"数",1*/
/* (16 X 16 , 宋体 ) */

0x00,0x00,0x00,0x00,0x00,0x00,0xC0,0x30,
0xC0,0x30,0x00,0x00,0x00,0x00,0x00,0x00,/*":",2*/
/* (8 X 16 , 宋体 ) */};
char map1[8][8]=
{         
		
		{1,1,1,1,1,1,1,1},
		{1,3,0,0,0,0,0,1},
		{1,0,1,1,1,0,0,1},
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		{1,1,1,1,1,1,1,1},
	
	};
char map2[8][8]=
	{	
		{1,1,1,1,1,1,1,1},
		{1,3,0,0,0,0,0,1},
		{1,0,1,1,1,1,0,1},
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		{1,1,1,1,1,1,1,1},
	};
	char map3[8][8]=
{         
		
		{1,1,1,1,1,1,1,1},
		{1,1,1,1,1,1,1,2},
		{1,0,0,3,4,0,0,1},
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		{1,1,1,1,1,1,1,1},
		
	};
void DrawMap1(char map[8][8]){
	u8 i,j,X,Y;
	X=Y=0;
	for (i=0;i<8;i++){
		for (j=0;j<8;j++){
			switch (map[i][j]){
		case (0):OLED_SHOW8X8(X,Y,8,8,Wall1);break;//空地
		case (1):OLED_SHOW8X8(X,Y,8,8,Wall);break;//墙
		case (2):OLED_SHOW8X8(X,Y,8,8,Wall);break;//无效区
		case (3):OLED_SHOW8X8(X,Y,8,8,goal);break;//目的地
		case (4):OLED_SHOW8X8(X,Y,8,8,boxs);break;//箱子
		case (6):OLED_SHOW8X8(X,Y,8,8,man);break;//人
		case (3+4):OLED_SHOW8X8(X,Y,8,8,good);break;//箱子加目的地
		case (3+6):OLED_SHOW8X8(X,Y,8,8,man);break;
			}
			X+=8;
			if(X==64){
				Y++;
				X=0;
			}
			
		}
//		printf ("\n");
	}
}
void FindManLocation(char *X,char *Y,char map[8][8])                   //找人
{
	u8 i,j,x,y;
	for (i=0;i<10;i++){
		for (j=0;j<10;j++){
			if (map[i][j]==6||map[i][j]==9){
				x=j+1;                                  //x=j+1,y=i+1
				y=i+1;
			}
		}
	}
	*X=x;
	*Y=y;
}
void MoveMan(char *X,char *Y,char map[8][8],char a)                                                   /*移动函数*/
{                                        
	char x,y;
	x=*X,y=*Y;
	switch (a){
	case 75:
	case ('a'):if (map[y-1][x-2]==1/*人左边是墙*/
				   ||(map[y-1][x-2]==4&&map[y-1][x-3]==1)/*箱子左边是墙*/
				   ||(map[y-1][x-2]==7&&map[y-1][x-3]==1)/*箱子在目的地且箱子左边是墙*/
				   ||((map[y-1][x-2]==7||map[y-1][x-2]==4)/*左边是箱子或箱子加目的地*/
				       &&(map[y-1][x-3]==4||map[y-1][x-3]==7/*左边的左边是箱子或箱子加目的地*/)/*不能推两个箱子*/));//如果是墙就不动,不能推两个箱子
				else 
				{if (map[y-1][x-2]!=4&&map[y-1][x-2]!=7)
					{                   //如果人左边不是箱子且不是箱子加目的地
					map[y-1][x-1]=map[y-1][x-1]-6;x--;map[y-1][x-1]=map[y-1][x-1]+6;
					}//向左走一步
						else 
							//如果人左边是箱子或是箱子加目的地
								{
								map[y-1][x-1]=map[y-1][x-1]-6/*原地变成空地*/;x--;map[y-1][x-1]=map[y-1][x-1]+2;/*箱子变成人*/map[y-1][x-2]=map[y-1][x-2]+4;
								}/*左边的左边变成箱子*/
				}       //否则推着箱子走一步
		break;
	case 77:
	case ('d'):if (map[y-1][x]==1/*人右边是墙*/
				   ||(map[y-1][x]==4&&map[y-1][x+1]==1)/*箱子右边是墙*/
				   ||(map[y-1][x]==7&&map[y-1][x+1]==1)/*箱子在目的地且箱子右边是墙*/
				   ||((map[y-1][x]==4||map[y-1][x]==7)/*右边是箱子或箱子加目的地*/
				       &&(map[y-1][x+1]==4||map[y-1][x+1]==7)/*右边的右边是箱子或箱子加目的地*/)/*不能推两个箱子*/);//如果是墙就不动,不能推两个箱子
				else 
				{if (map[y-1][x]!=4&&map[y-1][x]!=7)
					{                     //如果人右边不是箱子且不是箱子加目的地
					map[y-1][x-1]=map[y-1][x-1]-6;x++;map[y-1][x-1]=map[y-1][x-1]+6;
					}//向右走一步
						else 
						{
							map[y-1][x-1]=map[y-1][x-1]-6;x++;map[y-1][x-1]=map[y-1][x-1]+2;map[y-1][x]=map[y-1][x]+4;
						}//否则推着箱子走一步
				}
		break;
	case 80:
	case ('s'):if (map[y][x-1]==1/*人下边是墙*/
				   ||(map[y][x-1]==4&&map[y+1][x-1]==1)/*箱子下边是墙*/
				   ||(map[y][x-1]==7&&map[y+1][x-1]==1)/*箱子在目的地且箱子下边是墙*/
				   ||((map[y][x-1]==7||map[y][x-1]==4)/*下边是箱子或箱子加目的地*/
				       &&(map[y+1][x-1]==4||map[y+1][x-1]==7)/*下边的下边是箱子或箱子加目的地*/)/*不能推两个箱子*/);//如果是墙就不动,不能推两个箱子
				else 
				{if (map[y][x-1]!=4&&map[y][x-1]!=7)                   //如果人下边不是箱子且不是箱子加目的地
					{
					map[y-1][x-1]=map[y-1][x-1]-6;y++;map[y-1][x-1]=map[y-1][x-1]+6;
					}                                                     //向下走一步
						else                                              //人下边是箱子或是箱子加目的地
						{
							map[y-1][x-1]=map[y-1][x-1]-6;y++;map[y-1][x-1]=map[y-1][x-1]+2;map[y][x-1]=map[y][x-1]+4;
						}//否则推着箱子走一步
				}
		break;
	case 72:
	case ('w'):if (map[y-2][x-1]==1/*人上边是墙*/
				   ||(map[y-2][x-1]==4&&map[y-3][x-1]==1)/*箱子上边是墙*/
				   ||(map[y-2][x-1]==7&&map[y-3][x-1]==1)/*箱子在目的地且箱子上边是墙*/
				   ||((map[y-2][x-1]==7||map[y-2][x-1]==4)/*上边是箱子或箱子加目的地*/
				       &&(map[y-3][x-1]==4||map[y-3][x-1]==7))/*不能推两个箱子*/);//如果是墙就不动,不能推两个箱子
				else
				{if (map[y-2][x-1]!=4&&map[y-2][x-1]!=7)                  //如果人上边不是箱子且不是箱子加目的地
					{
					map[y-1][x-1]=map[y-1][x-1]-6;y--;map[y-1][x-1]=map[y-1][x-1]+6;
					}													      //向上走一步
						else                                                  //人下边是箱子或是箱子加目的地
						{
							map[y-1][x-1]=map[y-1][x-1]-6;y--;map[y-1][x-1]=map[y-1][x-1]+2;map[y-2][x-1]=map[y-2][x-1]+4;
						}//否则推着箱子走一步
				}	
		break;
	}
	*X=x,*Y=y;
}
void Level(char n,char map[8][8])
{
	char X,Y,i,j,m;
	m=X=Y=0;
	while(1){
		if(USART_RX_STA>0){

			Clear_OLED();
//			show_Str(1,0,8,16,USART_RX_BUF);
			FindManLocation(&X,&Y,map);                   //找人
			MoveMan(&X,&Y,map,USART_RX_BUF[0]);                                                  /*移动函数*/
			DrawMap1(map);
			USART_RX_STA=0;
			USART_Cmd(USART1,ENABLE);
			marking(map);                                     //计分数

		}
		for(i=0,m=0;i<8;i++)
			for(j=0;j<8;j++){
				if(map[i][j]==4)m++;
			}
		if(m==0){
			switch(n){
				case 1:Level(2,map2);
					break;
				case 2:Level(3,map3);
					break;
				case 3:
					break;
			}
		}
	}
}
void marking(char map[8][8])                                      //计分数

{
	u8 grade,i,j;
	for (grade=0,i=0;i<8;i++){
		for (j=0;j<8;j++){
			if (map[i][j]==7) 
				grade++;
			}
		}  	
	OLED_SHOW16X16(64,0,40,16,MARKING);
	OLED_SHOWNumber(104,0,16,16,grade);
}
